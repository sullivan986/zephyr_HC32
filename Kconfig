## Kconfig
```kconfig
# SPDX-License-Identifier: Apache-2.0

config HC32_CLOCK_PLL
	bool "Run the core at 64 MHz from the PLL"
	default y
	depends on SOC_HC32A052
	help
	  12 MHz RCH / 2 * 64 / 6 = 64 MHz, or XTH / n * m / k = 64 MHz when the
	  external crystal is selected below.

	  Disable this to stay on the 12 MHz RCH oscillator directly. That needs
	  no PLL lock and cannot hang waiting for one, which makes it a useful
	  first bring-up setting: the UART driver computes its baud rate from the
	  real PCLK, so the console keeps working either way.

if HC32_CLOCK_PLL

choice HC32_CLOCK_SRC
	prompt "PLL reference clock"
	default HC32_CLOCK_SRC_XTH
	help
	  Clock feeding the PLL.

	  The external crystal is preferred for anything timing sensitive: the
	  internal RCH is only trimmed to a few percent, which is not good
	  enough for CAN bit timing (a 1% budget covers both ends of the bus)
	  nor for a stable UART baud rate over temperature.

config HC32_CLOCK_SRC_XTH
	bool "External crystal (XTH)"

config HC32_CLOCK_SRC_RCH
	bool "Internal 12 MHz RC oscillator (RCH)"

endchoice

if HC32_CLOCK_SRC_XTH

choice HC32_XTH_FREQ
	prompt "XTH crystal frequency"
	default HC32_XTH_8MHZ
	help
	  Frequency of the crystal fitted on the board. Only the combinations
	  below keep the PLL voltage controlled oscillator inside the range the
	  vendor driver accepts (384..512 MHz) while producing exactly 64 MHz:

	      8 MHz / 1 * 64 / 8 = 64 MHz
	     12 MHz / 2 * 64 / 6 = 64 MHz
	     16 MHz / 2 * 64 / 8 = 64 MHz
	     24 MHz / 2 * 32 / 6 = 64 MHz

config HC32_XTH_8MHZ
	bool "8 MHz"

config HC32_XTH_12MHZ
	bool "12 MHz"

config HC32_XTH_16MHZ
	bool "16 MHz"

config HC32_XTH_24MHZ
	bool "24 MHz"

endchoice

endif # HC32_CLOCK_SRC_XTH

endif # HC32_CLOCK_PLL

config UART_HC32
	bool "XHSC HC32A052 USART driver"
	default y
	depends on SOC_HC32A052
	depends on SERIAL
	select SERIAL_HAS_DRIVER
	help
	  Enable the USART driver for XHSC HC32A052 series devices.
```

## boards/xhsc/hc32a052_stk/Kconfig.hc32a052_stk
```kconfig
# SPDX-License-Identifier: Apache-2.0

config BOARD_HC32A052_STK
	select SOC_HC32A052
```

## boards/xhsc/hc32a052_stk/board.yml
```yaml
# SPDX-License-Identifier: Apache-2.0

board:
  name: hc32a052_stk
  full_name: XHSC HC32A052 Starter Kit
  vendor: xhsc
  socs:
    - name: hc32a052
```

## dts/bindings/can/xhsc,hc32a052-can.yaml
```yaml
# SPDX-License-Identifier: Apache-2.0

description: |
  XHSC HC32A052 on-chip CAN controller.

  The vendor DDL has no pinctrl integration, so the pin routing is described
  directly. Port indices follow GPIOA..GPIOD = 0..3.

  The optional stby-port/stby-pin pair drives the transceiver standby input
  (the reference board uses PA8 and enables the transceiver by driving it low).
  Omit both if the transceiver is hard-wired for normal mode.

compatible: "xhsc,hc32a052-can"

include: can-controller.yaml

properties:
  reg:
    required: true

  interrupts:
    required: true

  tx-port:
    type: int
    required: true
    enum: [0, 1, 2, 3]
    description: GPIO port of the CAN_TX pin (0 = GPIOA).

  tx-pin:
    type: int
    required: true
    enum: [0, 1, 2, 3, 4, 5, 6, 7, 8, 9, 10, 11, 12, 13, 14, 15]
    description: CAN_TX pin number within tx-port.

  tx-af:
    type: int
    required: true
    enum: [0, 1, 2, 3, 4, 5, 6, 7]
    description: Alternate function mux value for CAN_TX (PA11 is AF4).

  rx-port:
    type: int
    required: true
    enum: [0, 1, 2, 3]
    description: GPIO port of the CAN_RX pin (0 = GPIOA).

  rx-pin:
    type: int
    required: true
    enum: [0, 1, 2, 3, 4, 5, 6, 7, 8, 9, 10, 11, 12, 13, 14, 15]
    description: CAN_RX pin number within rx-port.

  rx-af:
    type: int
    required: true
    enum: [0, 1, 2, 3, 4, 5, 6, 7]
    description: Alternate function mux value for CAN_RX (PA12 is AF4).

  stby-port:
    type: int
    enum: [0, 1, 2, 3]
    description: GPIO port of the transceiver standby pin.

  stby-pin:
    type: int
    enum: [0, 1, 2, 3, 4, 5, 6, 7, 8, 9, 10, 11, 12, 13, 14, 15]
    description: Transceiver standby pin number within stby-port.

examples:
  - |
    &can0 {
        status = "okay";
        bitrate = <500000>;
        tx-port = <0>;   /* PA11, AF4 */
        tx-pin = <11>;
        tx-af = <4>;
        rx-port = <0>;   /* PA12, AF4 */
        rx-pin = <12>;
        rx-af = <4>;
        stby-port = <0>; /* PA8, driven low to enable the transceiver */
        stby-pin = <8>;
    };
```

## dts/bindings/dma/xhsc,hc32a052-dma.yaml
```yaml
# SPDX-License-Identifier: Apache-2.0

description: |
  XHSC HC32A052 direct memory access controller.

  A channel specifier carries the channel index and the peripheral trigger
  selection value: <&dma0 channel slot>. Use slot 0 for software triggered
  memory-to-memory transfers, otherwise the DmaUart0TxTrig-style request
  number from the vendor DDL.

compatible: "xhsc,hc32a052-dma"

include: dma-controller.yaml

properties:
  dma-channels:
    required: true
    description: Number of channels (five on this SoC).

  "#dma-cells":
    const: 2

dma-cells:
  - channel
  - slot
```

## dts/bindings/pwm/xhsc,hc32a052-gtim.yaml
```yaml
# SPDX-License-Identifier: Apache-2.0

description: |
  XHSC HC32A052 general purpose timer (GTIM) used as a PWM controller.

  GTIM0 and GTIM1 each provide two compare/capture channels. Selecting them
  takes the shared silicon away from the BTIM blocks: GTIM0 replaces
  BTIM0/1/2 and GTIM1 replaces BTIM3/4/5.

  The vendor DDL has no port-mux abstraction, so the pin of every channel is
  described directly. Port indices follow GPIOA..GPIOD = 0..3. Omit the pin
  properties for channels that are not routed out.

compatible: "xhsc,hc32a052-gtim"

include: [pwm-controller.yaml, base.yaml]

properties:
  "#pwm-cells":
    const: 3

  ch0-port:
    type: int
    enum: [0, 1, 2, 3]
    description: GPIO port of channel 0 (0 = GPIOA).

  ch0-pin:
    type: int
    enum: [0, 1, 2, 3, 4, 5, 6, 7, 8, 9, 10, 11, 12, 13, 14, 15]
    description: Pin number of channel 0 within ch0-port.

  ch0-af:
    type: int
    default: 2
    enum: [0, 1, 2, 3, 4, 5, 6, 7]
    description: Alternate function mux value of channel 0.

  ch1-port:
    type: int
    enum: [0, 1, 2, 3]
    description: GPIO port of channel 1 (0 = GPIOA).

  ch1-pin:
    type: int
    enum: [0, 1, 2, 3, 4, 5, 6, 7, 8, 9, 10, 11, 12, 13, 14, 15]
    description: Pin number of channel 1 within ch1-port.

  ch1-af:
    type: int
    default: 2
    enum: [0, 1, 2, 3, 4, 5, 6, 7]
    description: Alternate function mux value of channel 1.

pwm-cells:
  - channel
  - period
  - flags
```

## dts/bindings/serial/xhsc,hc32a052-usart.yaml
```yaml
# SPDX-License-Identifier: Apache-2.0

description: |
  XHSC HC32A052 USART configured in asynchronous UART mode.

  The vendor DDL has no port-mux abstraction, so the pins are described
  directly. Port indices follow GPIOA..GPIOD = 0..3.

  Adding "dmas" entries with the names "tx" and "rx" moves transmission and
  reception to the DMAC when CONFIG_UART_ASYNC_API is enabled. The two cells
  of each specifier are the DMA channel and the USART request number.

compatible: "xhsc,hc32a052-usart"

include: uart-controller.yaml

properties:
  tx-port:
    type: int
    required: true
    enum: [0, 1, 2, 3]
    description: GPIO port of the TX pin (0 = GPIOA).

  tx-pin:
    type: int
    required: true
    enum: [0, 1, 2, 3, 4, 5, 6, 7, 8, 9, 10, 11, 12, 13, 14, 15]
    description: TX pin number within tx-port.

  tx-af:
    type: int
    default: 1
    enum: [0, 1, 2, 3, 4, 5, 6, 7]
    description: Alternate function mux value for the TX pin.

  rx-port:
    type: int
    enum: [0, 1, 2, 3]
    description: GPIO port of the RX pin (0 = GPIOA). Omit for TX-only.

  rx-pin:
    type: int
    enum: [0, 1, 2, 3, 4, 5, 6, 7, 8, 9, 10, 11, 12, 13, 14, 15]
    description: RX pin number within rx-port.

  rx-af:
    type: int
    default: 1
    enum: [0, 1, 2, 3, 4, 5, 6, 7]
    description: Alternate function mux value for the RX pin.

  dmas:
    type: phandle-array
    description: |
      Optional TX and RX DMA specifiers, in the order given by dma-names.

  dma-names:
    type: string-array
    description: |
      Names of the DMA specifiers. "tx" and "rx" are understood.
```

## soc/hc32a0/Kconfig.soc
```kconfig
# SPDX-License-Identifier: Apache-2.0

config SOC_FAMILY_XHSC
	bool
	help
	  XiaoHua Semiconductor (XHSC, formerly HDSC) HC32 MCU family.

config SOC_SERIES_HC32A0
	bool
	select ARM
	select SOC_FAMILY_XHSC
	select CPU_CORTEX_M0PLUS
	select CPU_CORTEX_M_HAS_SYSTICK
	select HAS_CMSIS_CORE
	help
	  XHSC HC32A0 series, ARM Cortex-M0+ based automotive MCUs.

config SOC_HC32A052
	bool
	select SOC_SERIES_HC32A0
	help
	  XHSC HC32A052: Cortex-M0+, 128 KiB flash, 16 KiB SRAM.

config SOC_FAMILY
	default "xhsc" if SOC_FAMILY_XHSC

config SOC_SERIES
	default "hc32a0" if SOC_SERIES_HC32A0

config SOC
	default "hc32a052" if SOC_HC32A052
```
